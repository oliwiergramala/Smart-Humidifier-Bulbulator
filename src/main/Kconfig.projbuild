## src/main/Kconfig.projbuild
```kconfig
menu "Application Configuration"

config WIFI_NAME
    string "WiFi SSID"
    default ""

config WIFI_PASSWORD
    string "WiFi password"
    default ""

endmenu
```
